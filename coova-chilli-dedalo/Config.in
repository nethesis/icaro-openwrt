## coova-chilli-dedalo/Config.in
```kconfig
# CoovaChilli advanced configuration

menu "Configuration"
	depends on PACKAGE_coova-chilli-dedalo

config COOVACHILLIDEDALO_PROXY
        bool "Enable support for chilli proxy. Required for AAA Proxy through http"
        default n

config COOVACHILLIDEDALO_REDIR
	bool "Enable support for redir server. Required for uamregex"
	default n

config COOVACHILLIDEDALO_MINIPORTAL
	bool "Enable support Coova miniportal"
	default n

config COOVACHILLIDEDALO_USERAGENT
	bool "Enable recording user-agent"
	default n

config COOVACHILLIDEDALO_DNSLOG
	bool "Enable support to log DNS name queries"
	default n

config COOVACHILLIDEDALO_UAMDOMAINFILE
	bool "Enable loading of mass uamdomains from file"
	default n

config COOVACHILLIDEDALO_LARGELIMITS
	bool "Enable larger limits for use with non-embedded systems"
	default n

choice
	prompt "SSL library"
	default COOVACHILLIDEDALO_NOSSL

config COOVACHILLIDEDALO_NOSSL
	bool "No SSL support"

config COOVACHILLIDEDALO_CYASSL
	bool "CyaSSL"

config COOVACHILLIDEDALO_OPENSSL
	bool "OpenSSL"

endchoice

endmenu
```
